## boards/qemu/x86/Kconfig
```kconfig
# Copyright (c) 2024 Intel Corporation
#
# SPDX-License-Identifier: Apache-2.0

config BOARD_QEMU_X86
	bool
	select CPU_HAS_FPU

config BOARD_QEMU_X86_64
	bool
	select X86_64

config BOARD_QEMU_X86_LAKEMONT
	bool
	select CPU_HAS_FPU

config BOARD_QEMU_X86_TINY
	bool
	select CPU_HAS_FPU

config BOARD_QEMU_X86_64_KVM
	bool
	select X86_64
	select X86_CPU_HAS_CET
```

## samples/subsys/display/lvgl/boards/frdm_mcxn947_mcxn947_cpu0.conf
```kconfig
CONFIG_INPUT=y
CONFIG_LED=y

#CONFIG_SPI_EXTENDED_MODES=y
CONFIG_LV_COLOR_16_SWAP=y

CONFIG_LOG_DEFAULT_LEVEL=3
CONFIG_DISPLAY_LOG_LEVEL_WRN=y

#CONFIG_SPI_NXP_LPSPI_DMA=n
```

## samples/subsys/display/lvgl/boards/mec172xevb_assy6906.conf
```kconfig
CONFIG_INPUT=y
CONFIG_GPIO_PCA95XX=n
CONFIG_LED=y

#CONFIG_SPI_EXTENDED_MODES=y
CONFIG_LV_COLOR_16_SWAP=y

CONFIG_LOG_DEFAULT_LEVEL=3
CONFIG_DISPLAY_LOG_LEVEL_WRN=y
```

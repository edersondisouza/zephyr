## CMakeLists.txt
```
# SPDX-License-Identifier: Apache-2.0

cmake_minimum_required(VERSION 3.20.0)

find_package(Zephyr REQUIRED HINTS $ENV{ZEPHYR_BASE})
project(hello_world)

target_sources(app PRIVATE src/main.c src/reloc.c)

zephyr_code_relocate(src/reloc.c SRAM2_LITERAL)
zephyr_code_relocate(src/reloc.c SRAM2_TEXT)
zephyr_code_relocate(src/reloc.c SRAM3_DATA)
zephyr_code_relocate(src/reloc.c SRAM3_RODATA)
zephyr_code_relocate(src/reloc.c SRAM4_BSS)
```

## prj.conf
```kconfig
# nothing here
#CONFIG_LOG=y
#CONFIG_LOG=n
#CONFIG_TEST_LOGGING_DEFAULTS=n
#CONFIG_LOG_MODE_IMMEDIATE=y
#CONFIG_ARM_MPU=n
CONFIG_OUTPUT_DISASSEMBLY=y

CONFIG_LLEXT=y
CONFIG_ZTEST=y

CONFIG_LLEXT_TYPE_ELF_RELOCATABLE=y

CONFIG_LLEXT_LOG_LEVEL_DBG=y
```

## boards/mec172xevb_assy6906_slot1.conf
```kconfig
CONFIG_MCUBOOT_IMGTOOL_SIGN_VERSION="0.0.3+0"
```

## boards/cortex_r8_virtual.overlay
```dts
/ {
    sram_afl: memory@80000000 {
        status = "okay";
        compatible = "mmio-sram";
        reg = <0x80000000 0x10000>; // 64KB SRAM
    };
};
```

## boards/mec172xevb_assy6906.overlay
```dts
/ {
    chosen {
        zephyr,code-partition = &slot0_partition;
    };
};
/* HACK ALERT!
   The real position for the code should be 0X000D8000,
   But CONFIG_FLASH_LOAD_OFFSET is 0x10000, due the partition slot
   being used. We probably need a config that tells MCUBOOT is
   going to copy image to RAM, so that CONFIG_FLASH_LOAD_OFFSET is
   not added to ROM_ADDRESS in the linker
   */
&flash0 {
    reg = <0x000C8000 0x50000>;
};
```

## boards/mec172xevb_assy6906_slot1.overlay
```dts
/ {
    chosen {
        zephyr,code-partition = &slot1_partition;
    };
};
/* HACK ALERT!
   The real position for the code should be 0X000D8000,
   But CONFIG_FLASH_LOAD_OFFSET is 0x40000, due the partition slot
   being used. We probably need a config that tells MCUBOOT is
   going to copy image to RAM, so that CONFIG_FLASH_LOAD_OFFSET is
   not added to ROM_ADDRESS in the linker
   */
&flash0 {
    reg = <0x00098000 0x50000>;
};
```

## src/main.c
```c
/*
 * Copyright (c) 2012-2014 Wind River Systems, Inc.
 *
 * SPDX-License-Identifier: Apache-2.0
 */

#include <zephyr/kernel.h>
#include <zephyr/llext/llext.h>
#include <zephyr/llext/buf_loader.h>
#include <zephyr/ztest.h>

/* Get memory from where to load ELF from devicetree */
#define SRAM_AFL DT_NODELABEL(sram_afl)
#define SRAM_AFL_SIZE DT_REG_SIZE(SRAM_AFL)

/* Buffer that holds the ELF binary, headed by its size */
struct afl_buffer {
	uint32_t size;
	uint8_t data[];
} __packed;

ZTEST(llext_afl, test_afl_loader)
{
	uintptr_t sram_afl = DT_REG_ADDR(SRAM_AFL);
	struct afl_buffer *afl_buf = (struct afl_buffer *)sram_afl;
	struct llext_buf_loader buf_loader = LLEXT_BUF_LOADER(afl_buf->data, afl_buf->size);
	struct llext_loader *loader = &buf_loader.loader;
	struct llext_load_param ldr_param = LLEXT_LOAD_PARAM_DEFAULT;
	struct llext *ext = NULL;
	int res;

	printk("SRAM AFL buffer size: %d bytes\n", afl_buf->size);
	if (afl_buf->size > SRAM_AFL_SIZE - sizeof(uint16_t)) {
		printk("Error: AFL buffer size exceeds SRAM AFL size!\n");
		return;
	}

	// Print first 64 bytes in hex format for debugging
	printk("AFL buffer data (first 64 bytes): ");
	for (int i = 0; i < 64 /*&& i < afl_buf->size*/; i++) {
		printk("%02x ", afl_buf->data[i]);
		if ((i + 1) % 16 == 0) {
			printk("\n");
		}
	}
	printk("\n");

	/* Tries to load the ELF */
	res = llext_load(loader, "afl", &ext, &ldr_param);

	if (res < 0) {
		printk("Error: Failed to load AFL extension, error code: %d\n", res);
		return;
	}

	/* If loading works, for good measure, to find a symbol */
	void (*test_entry_fn)() = llext_find_sym(&ext->exp_tab, "test_entry");
	if (!test_entry_fn) {
		printk("'test_entry' function not found in AFL extension.\n");
		llext_unload(&ext);
		return;
	}

	llext_unload(&ext);

	printk("Done!\n");

	return;
}

static void *ztest_suite_setup(void)
{
#ifdef CONFIG_LLEXT_HEAP_DYNAMIC
	/* Test runtime allocation of the LLEXT loader heap */
	zassert_ok(llext_heap_init(llext_heap_data, sizeof(llext_heap_data)));
	LOG_INF("Allocated LLEXT dynamic heap of size %uKB\n",
			(unsigned int)(sizeof(llext_heap_data)/KB(1)));
#endif
	return NULL;
}

static void ztest_suite_teardown(void *data)
{
	ARG_UNUSED(data);

#ifdef CONFIG_LLEXT_HEAP_DYNAMIC
	zassert_ok(llext_heap_uninit());
#endif
}

ZTEST_SUITE(llext_afl, NULL, ztest_suite_setup, NULL, NULL, ztest_suite_teardown);
```

## src/reloc.c
```c
/*
 * Copyright (c) 2012-2014 Wind River Systems, Inc.
 *
 * SPDX-License-Identifier: Apache-2.0
 */

#include <zephyr/kernel.h>

void reloc(void)
{
	printk("Hello World from relocated! [%p]\n", reloc);
}
```

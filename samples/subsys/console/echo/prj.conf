## prj.conf
```kconfig
CONFIG_CONSOLE_SUBSYS=y
CONFIG_CONSOLE_GETCHAR=y
CONFIG_CONSOLE_GETCHAR_BUFSIZE=64
CONFIG_CONSOLE_PUTCHAR_BUFSIZE=512

CONFIG_LOG=y
CONFIG_LOG_MODE_IMMEDIATE=y
```

## src/main.c
```c
/*
 * Copyright (c) 2017 Linaro Limited
 *
 * SPDX-License-Identifier: Apache-2.0
 */
#include <zephyr/kernel.h>
#include <zephyr/console/console.h>

static const char prompt[] = "Start typing characters to see them echoed back\r\n";

int main(void)
{
	console_init();

	printk("You should see another line with instructions below. If not,\n");
	printk("the (interrupt-driven) console device doesn't work as expected:\n");
	console_write(NULL, prompt, sizeof(prompt) - 1);

	void (*crash)(void) = NULL;
	while (1) {
		uint8_t c = console_getchar();
		if (c == 'a') {
			crash();
		}

		console_putchar(c);
		if (c == '\r') {
			console_putchar('\n');
		}
	}
	return 0;
}
```

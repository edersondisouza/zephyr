## drivers/flash/Kconfig.aardvark_i2c
```kconfig
config FLASH_AARDVARK_I2C
	bool "Aardvark I2C Host Adapter"
	depends on I2C && DT_HAS_AARDVARK_I2C_FLASH_CONTROLLER_ENABLED
	select FLASH_HAS_DRIVER_ENABLED
	select FLASH_HAS_PAGE_LAYOUT
	help
	  Say Y here if you have an Aardvark I2C Host Adapter from
	  Total Phase.

if FLASH_AARDVARK_I2C

config FLASH_AARDVARK_I2C_INIT_PRIORITY
	int "Aardvark I2C Host Adapter init priority"
	default 99
	help
	  This option sets the priority of the Aardvark I2C/SPI Host Adapter
	  initialization. Must be higher than that of the I2C bus driver.

endif # FLASH_AARDVARK_I2C
```

## dts/bindings/flash_controller/aardvark,i2c-flash-controller.yaml
```yaml
description: Aardvarn I2C flash controller

compatible: "aardvark,i2c-flash-controller"

include: flash-controller.yaml

properties:
  device:
    type: phandle
    description: The I2C device node
```

## tests/drivers/adc/adc_accuracy_test/Kconfig
```kconfig
mainmenu "ADC accuracy test"

source "Kconfig.zephyr"

# Workaround to have commas on function arguments
ZEPHYR_USER := zephyr,user

config DAC_SOURCE_TEST
    bool
    default y if $(dt_node_has_prop,/$(ZEPHYR_USER),dac)

config REFERENCE_VOLTAGE_TEST
    bool
    default y if $(dt_node_has_prop,/$(ZEPHYR_USER),reference_mv)
```

## tests/drivers/adc/adc_accuracy_test/testcase.yaml
```yaml
common:
  tags:
    - adc
    - drivers
  depends_on:
    - adc
tests:
  drivers.adc.accuracy.dac_source:
    depends_on:
      - dac
    harness_config:
      fixture: dac_adc_loopback
  drivers.adc.accuracy.ref_volt:
    harness_config:
      fixture: adc_ref_volt
```
